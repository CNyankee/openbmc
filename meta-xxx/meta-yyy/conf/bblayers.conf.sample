## meta-xxx/meta-yyy/conf/bblayers.conf.sample
```bitbake
# LAYER_CONF_VERSION is increased each time build/conf/bblayers.conf
# changes incompatibly
LCONF_VERSION = "14"

BBPATH = "${TOPDIR}"
BBFILES ?= ""

BBLAYERS ?= " \
  ##OEROOT##/meta \
  ##OEROOT##/meta-poky \
  ##OEROOT##/meta-openembedded/meta-oe \
  ##OEROOT##/meta-openembedded/meta-networking \
  ##OEROOT##/meta-openembedded/meta-perl \
  ##OEROOT##/meta-openembedded/meta-python \
  ##OEROOT##/meta-phosphor \
  ##OEROOT##/meta-aspeed \
  ##OEROOT##/meta-x86 \
  ##OEROOT##/meta-xxx \
  ##OEROOT##/meta-intel-openbmc \
  ##OEROOT##/meta-xxx/meta-common \
  ##OEROOT##/meta-xxx/meta-common-small \
  ##OEROOT##/meta-xxx/meta-ast2500 \
  ##OEROOT##/meta-xxx/meta-yyy \
  ##OEROOT##/meta-security \
  "
```

## meta-xxx/meta-yyy/conf/layer.conf
```bitbake
LOCALCONF_VERSION = "4"
# We have a conf and classes directory, add to BBPATH
BBPATH .= ":${LAYERDIR}"

# We have recipes-* directories, add to BBFILES
BBFILES += "${LAYERDIR}/recipes-*/*/*.bb \
            ${LAYERDIR}/recipes-*/*/*.bbappend"

BBFILE_COLLECTIONS += "yyy"
BBFILE_PATTERN_yyy = "^${LAYERDIR}/"
BBFILE_PRIORITY_yyy = "11"
LAYERSERIES_COMPAT_yyy = "dunfell gatesgarth"

PRODUCT_GENERATION = "prl"
```
